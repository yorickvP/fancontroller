## fw/main/Kconfig.projbuild
```kconfig
menu "Fancontroller"
    menu "Wifi"
        config WIFI_SSID
            string "SSID"
        config WIFI_PASSPHRASE
            string "Passphrase"
    endmenu
endmenu
```
